#include "SSD1306.h"

uint8_t SlaveAddress;                  //011110+SA0+RW
uint8_t  WIDTH, HEIGHT;   // this is the 'raw' display w/h - never changes
uint8_t  _width, _height; // dependent on rotation
uint8_t  cursor_x, cursor_y;
uint8_t  textcolor, textbgcolor;
uint8_t  textsize;
uint8_t  rotation;
bool  wrap; // If set, 'wrap' text at right edge of display

static uint8_t buffer[128 * 64 / 8] = {
0x00, 0x00, 0x00, 0x00, 0x00, 0x00, 0x00, 0x00, 0x00, 0x00, 0x00, 0x00, 0x00, 0x00, 0x00, 0x00,
0x00, 0x00, 0x00, 0x00, 0x00, 0x00, 0x00, 0x00, 0x00, 0x00, 0x00, 0x00, 0x00, 0x00, 0x08, 0xF8,
0xF8, 0xF0, 0xF0, 0xE0, 0x80, 0x00, 0x00, 0x00, 0x00, 0x00, 0x00, 0x00, 0x00, 0x00, 0x00, 0x00,
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0x00, 0x00, 0x00, 0x00, 0x00, 0x00, 0x00, 0x00, 0x00, 0x00, 0x00, 0x00, 0x00, 0x00, 0x00, 0x00
};

void constructor(uint8_t w, uint8_t h) 
{
  _width = WIDTH = w;
  _height = HEIGHT = h;

  rotation = 0;    
  cursor_y = cursor_x = 0;
  textsize = 1;
  textcolor = textbgcolor = WHITE;  
  wrap = true;
}

void sendCommand(unsigned char command)
{
  Write_Byte(0x3C << 1, GOFi2cOLED_Command_Mode, command);
}

void setBrightness(unsigned char Brightness)
{
   sendCommand(Set_Contrast_Cmd);
   sendCommand(Brightness);
}

//void swap(int a, int b)
//{
//	int t = a;
//	a = b;
//	b = t;
//}

void drawPixel(uint8_t x, uint8_t y, uint8_t color) 
{
//  if ((x < 0) || (x >= _width) || (y < 0) || (y >= _height))
//    return;

//  // check rotation, move pixel around if necessary
//  switch () 
//	{
//  case 1:
//    swap(x, y);
//    x = WIDTH - x - 1;
//    break;
//  case 2:
//    x = WIDTH - x - 1;
//    y = HEIGHT - y - 1;
//    break;
//  case 3:
//    swap(x, y);
//    y = HEIGHT - y - 1;
//    break;
//  };  
//  // x is which column
//  if (color == WHITE) 
//    buffer[x+ (y/8)*128] |= _BV((y%8));  
//  else
//    buffer[x+ (y/8)*128] &= ~_BV((y%8)); 
}

uint8_t getRotation(void) 
{
  rotation %= 4;
  return rotation;
}

void setHorizontalMode()
{
    sendCommand(Set_Memory_Addressing_Mode_Cmd); 	//set addressing mode
    sendCommand(HORIZONTAL_MODE); 			//set horizontal addressing mode
}

void display(void) 
{
  sendCommand(0x00 | 0x0);  // low col = 0
  sendCommand(0x10 | 0x0);  // hi col = 0
  sendCommand(0x40 | 0x0); // line #0
	
    // save I2C bitrate
//    uint8_t twbrbackup = TWBR;
//    TWBR = 12; // upgrade to 400KHz!

    // I2C
    for (uint16_t i=0; i<(128*64/8); i++) 
    {
					// send a bunch of data in one xmission
					/* While the bus is busy */
			while (I2C_GetFlagStatus(SSD1306_I2C, I2C_FLAG_BUSY));
			
			/* Generate Start */
			I2C_GenerateSTART(SSD1306_I2C, ENABLE);
			
			/* Check if started */
			while (!I2C_CheckEvent(SSD1306_I2C, I2C_EVENT_MASTER_MODE_SELECT));
			
			/* Send 7bit address with transmitter bit */
			I2C_Send7bitAddress(SSD1306_I2C, 0x3C << 1, I2C_Direction_Transmitter); 
			
			/* Check if sent 7 bit address */
			while(!I2C_CheckEvent(SSD1306_I2C, I2C_EVENT_MASTER_TRANSMITTER_MODE_SELECTED));          // data mode
					
			/* Send Register address to write to */
			I2C_SendData(SSD1306_I2C, GOFi2cOLED_Data_Mode);
		
			/* Check Sent */
			while (!I2C_CheckEvent(SSD1306_I2C, I2C_EVENT_MASTER_BYTE_TRANSMITTED));
	
      for (uint8_t x=0; x<16; x++) 
      {
					/* Send value */
				I2C_SendData(SSD1306_I2C, buffer[i]);
		
				/* Check Sent and clear */
				while (!I2C_CheckEvent(SSD1306_I2C, I2C_EVENT_MASTER_BYTE_TRANSMITTED));
        i++;
      }  
      i--;
				/* Generate Stop */
			I2C_GenerateSTOP(SSD1306_I2C, ENABLE);
    }
//    TWBR = twbrbackup;
}

void drawBitmap(uint8_t x, uint8_t y, 
			      const uint8_t *bitmap, uint8_t w, uint8_t h,
			      uint8_t color) 
{
//  for (uint8_t j=0; j<h; j++) {
//    for (uint8_t i=0; i<w; i++ ) {
//      if (pgm_read_byte(bitmap + i + (j/8)*w) & _BV(j%8)) {
//	drawPixel(x+i, y+j, color);
//      }
//    }
//  }
}
				
void setTextSize(uint8_t s) 
{
  textsize = (s > 0) ? s : 1;
}

void setCursor(uint8_t x, uint8_t y)
{
  cursor_x = x;
  cursor_y = y;
}

void setTextColor(uint8_t c, uint8_t b) 
{
   textcolor = c;
   textbgcolor = b; 
 }

void clearDisplay()
{
  //memset(buffer, 0, (128*64/8));
}

void sendData(unsigned char Data)
{
  /* While the bus is busy */
  while (I2C_GetFlagStatus(SSD1306_I2C, I2C_FLAG_BUSY));
	
	/* Generate Start */
	I2C_GenerateSTART(SSD1306_I2C, ENABLE);
	
	/* Check if started */
	while (!I2C_CheckEvent(SSD1306_I2C, I2C_EVENT_MASTER_MODE_SELECT));
	
	/* Send 7bit address with transmitter bit */
	I2C_Send7bitAddress(SSD1306_I2C, 0x3C << 1, I2C_Direction_Transmitter); 
	
	/* Check if sent 7 bit address */
	while(!I2C_CheckEvent(SSD1306_I2C, I2C_EVENT_MASTER_TRANSMITTER_MODE_SELECTED));
	/* Send Register address to write to */
	I2C_SendData(SSD1306_I2C, GOFi2cOLED_Data_Mode);
	
	/* Check Sent */
	while (!I2C_CheckEvent(SSD1306_I2C, I2C_EVENT_MASTER_BYTE_TRANSMITTED));

             // stop I2C transmission
}
void init(uint8_t address)
{
 	//wait for OLED hardware init
 constructor(128, 64);
 SlaveAddress = address;

 sendCommand(GOFi2cOLED_Display_Off_Cmd);    /*display off*/

 sendCommand(Set_Multiplex_Ratio_Cmd);    /*multiplex ratio*/
 sendCommand(0x3F);    /*duty = 1/64*/

 sendCommand(Set_Display_Offset_Cmd);    /*set display offset*/
 sendCommand(0x00);


 sendCommand(0xB0); 			//set page address
 sendCommand(0x00); 	//set column lower address
 sendCommand(0x10); 	//set column higher address

 setHorizontalMode();        /*set Page Addressing Mode*/

 sendCommand(0x40);    /*set display starconstructort line*/

 sendCommand(Set_Contrast_Cmd);    /*contract control*/
 sendCommand(0xcf);    /*128*/

 sendCommand(Segment_Remap_Cmd);    /*set segment remap*/

 sendCommand(COM_Output_Remap_Scan_Cmd);    /*Com scan direction*/

 sendCommand(GOFi2cOLED_Normal_Display_Cmd);    /*normal / reverse*/

 sendCommand(Set_Display_Clock_Divide_Ratio_Cmd);    /*set osc division*/
 sendCommand(0x80);

 sendCommand(Set_Precharge_Period_Cmd);    /*set pre-charge period*/
 sendCommand(0xf1);

 sendCommand(Set_COM_Pins_Hardware_Config_Cmd);    /*set COM pins*/
 sendCommand(0x12);

 sendCommand(Set_VCOMH_Deselect_Level_Cmd);    /*set vcomh*/
 sendCommand(0x30);

 sendCommand(Deactivate_Scroll_Cmd);

 sendCommand(Charge_Pump_Setting_Cmd);    /*set charge pump enable*/
 sendCommand(Charge_Pump_Enable_Cmd);

 sendCommand(GOFi2cOLED_Display_On_Cmd);    /*display ON*/
}

void Write_Byte(u8 Device_address, u8 Register_address, u8 Value)
{
	/* While the bus is busy */
  while (I2C_GetFlagStatus(SSD1306_I2C, I2C_FLAG_BUSY));
	
	/* Generate Start */
	I2C_GenerateSTART(SSD1306_I2C, ENABLE);
	
	/* Check if started */
	while (!I2C_CheckEvent(SSD1306_I2C, I2C_EVENT_MASTER_MODE_SELECT));
	
	/* Send 7bit address with transmitter bit */
	I2C_Send7bitAddress(SSD1306_I2C, Device_address, I2C_Direction_Transmitter); 
	
	/* Check if sent 7 bit address */
	while(!I2C_CheckEvent(SSD1306_I2C, I2C_EVENT_MASTER_TRANSMITTER_MODE_SELECTED)); 
	
	/* Send Register address to write to */
	I2C_SendData(SSD1306_I2C, Register_address);
	
	/* Check Sent */
	while (!I2C_CheckEvent(SSD1306_I2C, I2C_EVENT_MASTER_BYTE_TRANSMITTED));
	
	/* Send value */
	I2C_SendData(SSD1306_I2C, Value);
	
	/* Check Sent and clear */
  while (!I2C_CheckEvent(SSD1306_I2C, I2C_EVENT_MASTER_BYTE_TRANSMITTED));
	
	/* Generate Stop */
	I2C_GenerateSTOP(SSD1306_I2C, ENABLE);
}

